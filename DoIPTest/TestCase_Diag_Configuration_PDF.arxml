AUTOSAR XML (schema 4-0-3)
# (C) 2014 Hyundai AUTRON
# Confidential Proprietary Information. Distribution Limited.
# Do Not Copy Without Prior Permission
package /AUTRON
  ecuc definition collection AUTRON_ParameterDefinition_TestCase: module=TestCase_Diag
  module definition TestCase_Diag: variants pre-compile
    container Diag_TestSeq [0..*]  # Contains the general configuration parameters of the module.
      integer SeviceId: 0..1023, origin=AUTRON, default-value=0  # This attribute specifies the default value of this logical analog input. The possible values are between 0-1023.
      integer TimeDelay: 0..100000, origin=AUTRON, default-value=0  # This attribute specifies the default value of this logical analog input. The possible values are between 0-1023.
      boolean FunctionalId: origin=AUTRON, default-value=true
      boolean Sub_FunctionAvail: origin=AUTRON, default-value=true
      integer SubFunction: 0..100000, origin=AUTRON, default-value=0  # This attribute specifies the default value of this logical analog input. The possible values are between 0-1023.
      string data [1..*]: set at pre-compile, origin=AUTRON  # Header file name which shall be included by the NvM. | The value of this parameter shall be used as h-char-sequence or q-char-sequence according to ISO C90 section 6.10.2 "source file inclusion". The parameter value MUST NOT represent a path, since ISO C90 does not specify how such a path is treated (i.e., this is implementation defined (and additionally depends on the operating system and the underlying file system)).
      string ExpectedResult [1..*]: set at pre-compile, origin=AUTRON  # Header file name which shall be included by the NvM. | The value of this parameter shall be used as h-char-sequence or q-char-sequence according to ISO C90 section 6.10.2 "source file inclusion". The parameter value MUST NOT represent a path, since ISO C90 does not specify how such a path is treated (i.e., this is implementation defined (and additionally depends on the operating system and the underlying file system)).
      string TestInformation: set at pre-compile, origin=AUTRON  # Header file name which shall be included by the NvM. | The value of this parameter shall be used as h-char-sequence or q-char-sequence according to ISO C90 section 6.10.2 "source file inclusion". The parameter value MUST NOT represent a path, since ISO C90 does not specify how such a path is treated (i.e., this is implementation defined (and additionally depends on the operating system and the underlying file system)).
    container Diag_TestGeneral  # Contains the general configuration parameters of the module.
      integer FunctionalTxId: 0..4095, origin=AUTRON, default-value=0  # This attribute specifies the default value of this logical analog input. The possible values are between 0-1023.
      integer PhysicalTxId: 0..4095, origin=AUTRON, default-value=0  # This attribute specifies the default value of this logical analog input. The possible values are between 0-1023.
      integer PhysicalRxId: 0..4095, origin=AUTRON, default-value=0  # This attribute specifies the default value of this logical analog input. The possible values are between 0-1023.
      integer Speed: 0..1023, origin=AUTRON, default-value=0  # This attribute specifies the default value of this logical analog input. The possible values are between 0-1023.
