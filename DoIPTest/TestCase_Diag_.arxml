AUTOSAR XML (schema 4-0-3)
package /AUTOSAR
  module config Diag: definition=TestCase_Diag, implementation-config-variant=VARIANT-PRE-COMPILE, module-description=BswImplementation_NvM
    8 x Diag_TestSeq, all with TimeDelay=500, FunctionalId=0:
      Diag_TestSeq0: Sub_FunctionAvail=1, SeviceId=0x10, SubFunction=0x03, ExpectedResult=0x50, ExpectedResult=0x03, TestInformation=To Check change session based on input(0x03, Extended Sesstion)
      Diag_TestSeq1: Sub_FunctionAvail=1, SubFunction=0x01, SeviceId=0x10, ExpectedResult=0x50, ExpectedResult=0x01, TestInformation=To Check change session based on input(0x01, Default Sesstion)
      Diag_TestSeq2: Sub_FunctionAvail=1, SeviceId=0x10, SubFunction=0x03, ExpectedResult=0x50, ExpectedResult=0x03, TestInformation=To Check change session based on input(0x03, Extended Sesstion)
      Diag_TestSeq3: SeviceId=0x22, Sub_FunctionAvail=0, ExpectedResult=0x62, ExpectedResult=0xf1, TestInformation=ReadDataById Test (+ Diag TP Rx Test), data=0xf1, data=0x90, ExpectedResult=0x90, ExpectedResult=0x01, ExpectedResult=0x02, ExpectedResult=0x03, ExpectedResult=0x04, ExpectedResult=0x05, ExpectedResult=0x06, ExpectedResult=0x07, ExpectedResult=0x08, ExpectedResult=0x09, ExpectedResult=0x0a, ExpectedResult=0x0b, ExpectedResult=0x0c, ExpectedResult=0x0d, ExpectedResult=0x0e, ExpectedResult=0x0f, ExpectedResult=0x10, ExpectedResult=0x11
      Diag_TestSeq4: SeviceId=0x2e, Sub_FunctionAvail=1, SubFunction=0xf1, data=0x90, data=0x57, data=0x1, data=0x2, data=0x3, data=0x4, data=0x5, data=0x6, data=0x7, data=0x8, data=0x9, data=0xa, data=0xb, data=0xc, data=0xd, data=0xe, data=0xf, data=0x10, ExpectedResult=0x6e, TestInformation=WriteDataById Test (+ Diag TP Tx Test)
      Diag_TestSeq5: Sub_FunctionAvail=1, SeviceId=0x10, SubFunction=0x03, ExpectedResult=0x50, ExpectedResult=0x03, TestInformation=To Check change session based on input(0x03, Extended Sesstion)
      Diag_TestSeq6: SeviceId=0x27, Sub_FunctionAvail=1, SubFunction=0x01, ExpectedResult=0x67, ExpectedResult=0x01, TestInformation=Security Access Test : Request seed key of Security Level 1
      Diag_TestSeq7: SeviceId=0x27, Sub_FunctionAvail=1, SubFunction=0x02, ExpectedResult=0x67, ExpectedResult=0x02, data=0x05, data=0x06, data=0x07, data=0x08, TestInformation=Security Access Test : Send the generated key of Security Level 1
    Diag_TestGeneral
